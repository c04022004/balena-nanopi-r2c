## layers/meta-balena-nanopi-r2c/conf/machine/orangepi-r1-plus-lts.conf
```bitbake
#@TYPE: Machine
#@NAME: orangepi-r1-plus-lts
#@DESCRIPTION: Machine configuration for the OrangePi R1 Plus LTS, based on the Rockchip RK3328 SoC

require conf/machine/nanopi-r2s.conf

PREFERRED_PROVIDER_virtual/kernel = "linux-rockchip"
PREFERRED_VERSION_linux-rockchip = "5.15%"

PREFERRED_VERSION_u-boot = "2021.07"

KBUILD_DEFCONFIG = "orangepi_r1_plus_lts_rk3328_defconfig"
KERNEL_DEVICETREE = "rockchip/rk3328-orangepi-r1-plus.dtb"
```
